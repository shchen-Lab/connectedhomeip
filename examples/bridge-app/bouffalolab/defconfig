## examples/bridge-app/bouffalolab/defconfig
```kconfig
CONFIG_BFLB_LOG                              = n
CONFIG_COREDUMP                             ?= n
CONFIG_VSNPRINTF_NANO                       = n
CONFIG_VSNPRINTF_FLOAT                      = y
CONFIG_VSNPRINTF_FLOAT_EX                   = y
CONFIG_VSNPRINTF_LONG_LONG                  = y

CONFIG_BFLB_MTD                             = y
CONFIG_PARTITION                            = y
CONFIG_LITTLEFS                             = y
CONFIG_FOTA                                 = y

CONFIG_FREERTOS                             = y
CONFIG_NEWLIB                               = n
CONFIG_NEWLIB_STANDARD                      = n
CONFIG_POSIX                                = n
CONFIG_TLSF                                 = y

CONFIG_CONSOLE_UART_BAUDRATE                = 2000000
CONFIG_NO_SHORT_ENUMS                       = y
CONFIG_STDATOMIC                            = y
CONFIG_MM_ENABLE_MIN_FREE_TRACKING          = y
CONFIG_MATTER                               = y

CONFIG_MBEDTLS                              = y
CONFIG_MBEDTLS_V2                           = n
CONFIG_MBEDTLS_AES_USE_HW                   = y
CONFIG_MBEDTLS_BIGNUM_USE_HW                = y
CONFIG_MBEDTLS_ECC_USE_HW                   = y
CONFIG_MBEDTLS_SHA1_USE_HW                  = y
CONFIG_MBEDTLS_SHA256_USE_HW                = y
CONFIG_MBEDTLS_SHA512_USE_HW                = y

ifneq ($(CONFIG_MBEDTLS_V2),y)
  CONFIG_MBEDTLS_CIPHER_CCM_ENABLED         = y
  CONFIG_MBEDTLS_HKDF_C                     = y
  CONFIG_MBEDTLS_X509_CSR_WRITE_C           = y
  CONFIG_MBEDTLS_HMAC_DRBG_ENABLED          = y
  CONFIG_MBEDTLS_CMAC                       = y
  CONFIG_MBEDTLS_ECDSA_DETERMINISTIC        = y
endif

ifeq ($(CONFIG_WIFI),y)
  CONFIG_RF                                 = y
  CONFIG_BLUETOOTH                          = y
  CONFIG_BTBLECONTROLLER_LIB                = m2s1
  CONFIG_BL_SDK                             = y
  CONFIG_BLE_USE_MAC2                       = n
  CONFIG_BLE_USING_DYNAMIC_RAM              = y
  CONFIG_BT_OAD_SERVER                      = n
  CONFIG_BT_STACK_CLI                       = n

  CONFIG_WIFI6                              = y
  CONFIG_MACSW_SELECT                       = default
  CONFIG_FHOST                              = y
  CONFIG_DHCPD                              = y
  CONFIG_LWIP                               = y
  CONFIG_PING                               = n
endif
```
